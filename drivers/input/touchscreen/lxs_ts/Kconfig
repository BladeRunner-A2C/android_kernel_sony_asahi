## drivers/input/touchscreen/lxs_ts/Kconfig
```kconfig
menu "LXS Touch Support"

config TOUCHSCREEN_LXS
	tristate "LX Semicon Touch Driver Core"
	depends on SPI_MASTER || I2C
	default n
	help
	  Say Y here if you have a touchscreen interface using
	  the LX Semicon touch device.

endmenu
```

## drivers/power/supply/battchg_ext/Kconfig
```kconfig
config SOMC_BATTERY_CHARGER
	tristate "SOMC Battery Charger"
	depends on I2C
	help
	  Say Y to include support for SOMC Battery Charger.
	  The driver supports SOMC charger used by SONY Xperia 1VI device.
```
